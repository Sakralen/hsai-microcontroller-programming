/*=============================================================================*\
  APN: Тестирование работы с параллельнми портами
  Смотри ремарки в файле <Параллельные порты в STM32F10x.docx>
  
  Файл ParP_Regs(2) - вариант программы управления светофором, в котором
использовано определение функций отдельных битов и выводов порта для определенных
действий, так, что манипуляции с уже назначенными для определенной функциональности
битами, не приводят к влиянию на прочие биты, как не задействованные, так и на 
задействованные.
   Определения битов, используемых для управления светофором вынесено в заголовочный 
файл  ParP. h.
   При определении массива описания диаграммы Diagr[][2] использована директива
условной трансляции (строки 34 и 37). Если определена константа PEDESTRIANS (строка 24
не закомментирована), то транслируются строки 35 и 36, в диаграмме появляются еще 
две фазы, организующие пешеходный такт в диаграмме светофора.

  
\*=============================================================================*/

  //  Макрос для одновременного сброса+установки (разных) битов в порте
  // прямой записью в регистр GPIO_SetRstBits
#define GPIO_SetRstBits(GPIOx,SetPins,RstPins) GPIOx->BSRR=SetPins|(RstPins<<16)

#define PEDESTRIANS
    // ----- #include directives ------------------------------------------
#include <stm32f10x.h>
#include "ParP.h"

    // ---------- Global variables -----------------------------------------
u32 Diagr[][2] =                  //  Массив, описывающий диаграмму работы светофора
{   NS_Red|WO_Green,      GR_T,   // Количество фаз теперь можно задать любым.
    NS_Yellow|WO_Yellow,  YY_T,   //
    NS_Green|WO_Red,      GR_T,   //
#ifdef PEDESTRIANS
    NS_Yellow|WO_Red,     YY_T,
    NS_Pdst|WO_Pdst|NS_Red|WO_Red, GR_T,   //  Пешеходный такт
#endif
    NS_Yellow|WO_Yellow,  YY_T,   //
    0,                    0
};

u32 uiA;
u32 uiT1, uiT2, uiDT;

    // ----- Function definitions --------------------------------------------
void Delay(u32 uiTDel) {while (uiTDel--) {} }	

    // ===== Function main() =================================================
int main(void)
{  // Manage PortC	
  RCC->APB2ENR |= RCC_APB2ENR_IOPAEN | RCC_APB2ENR_IOPCEN;        
      //  Разрешение тактирования порта А (опрос кнопки USER) и порта С (лампы светофора)

  GPIOC->CRL |= 0x33333333;         // Выводы 0...7 порта С - выходы 50 МГц для светофора

  SysTick->LOAD = 0xFFFFFF;
  SysTick->CTRL = 5;
  uiT1 = SysTick->VAL;
  Delay(100000);
  uiT2 = SysTick->VAL;
  uiDT = uiT1-uiT2;


  uiA = SvetMask;
  int i;
  while(1) {
    i=0;
    do {          //  Зажечь комбинацию ламп, соответственно такту
      GPIOC->BSRR = (Diagr[i][0]) & uiA | ((~(Diagr[i][0])&uiA))<<16; //  Управление через BSRR
      Delay(Diagr[i][1]);
      i++;
    } while (Diagr[i][1]!=0);     
		while(((GPIOA->IDR)&1)==1);   //  Остановка в конце диагр. по нажатию кнопки USER
  }
	return 0;
}
