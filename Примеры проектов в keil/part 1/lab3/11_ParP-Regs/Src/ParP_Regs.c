/*=============================================================================*\
  APN: Тестирование работы с параллельнми портами на платах Nucleo и Discovery
c МК STM32F10xRB
  
  Конфигурация [ParP-Regs] - использует технику работы с параллельными
портами путем обращения напрямую к регистрам.

  Разница между платами
на Nucleo    - СвДиод (зел), подключен к выводу PA5, 
             - Кнопка USER подключена к выводу PC13

на Discovery - СвДиоды подкл. к выводам PC8(гол) и PC9(зел)
             - кнопка к выводу PA0
             
    При отладке на симуляторе задержка 10000, для платы задержка 1000000
\*=============================================================================*/

// ---- Директивы #include подключают заголовочные файлы -----------------------
#include <stm32f10x.h>

// ---- Директивы #define - определения для 
// #define NUC   //  Константа, разрешающая трансляцию для платы Nucleo

// ---- Глобальные переменные -----------------------------------------


    // ----- Function definitions --------------------------------------------
void Delay(u32 uiTDel) 
  {
    while (uiTDel--) {} 
  }	

    // ===== Function main() =================================================
int main(void)
{  	//  Разрешение тактирования порта А и порта С 
    // (к (разным)выводам этих портов на платах подключены кнопка User и СвДиоды)
  RCC->APB2ENR |= RCC_APB2ENR_IOPAEN | RCC_APB2ENR_IOPCEN;        

    //  Включение режима "вывод" для светодиода
#ifdef NUC
  GPIOA->CRL = 0x44344444;  //  Вывод PA5 - для управления USER СД Nucleo
#else
  GPIOC->CRH = 0x44444443;  //  Вывод PC8 - для управления USER СД Discovery
#endif

  while(1) {
#ifdef NUC
    GPIOA->ODR ^=1<<5;      //  USER СвДиод Nucleo    (1 - горит)
#else
    GPIOC->ODR ^=1<<8;      //  USER СвДиод Discovery (1 - горит)
#endif
    Delay(1000000);
            //  Остановка в конце диагр. по нажатию кнопки USER
#ifdef NUC
		while(((GPIOC->IDR)&(1<<13))==(1<<13))
      {                     //  USER кнопка Nucleo к PC13 (нажата - 0)
        __NOP();
      }
#else
		while(((GPIOA->IDR)&(1<<0)) !=(1<<0))    
      {                     //  USER кнопка Discovery к PA0 (нажата - 1)
        __NOP();
      }
#endif   
  }
//	return 0;
}
